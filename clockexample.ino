//=======================================
//Libraries used for weather/time lookup
//=======================================
#include <ESP8266HTTPClient.h>
#include <ESP8266WiFi.h>
#include <ArduinoJson.h> 
#include <WifiClient.h>
#include <time.h>
//===========================================
//Libraries used to configure SSD1306 display
//===========================================
#include <SPI.h>
#include <Wire.h>
#include <Adafruit_GFX.h>
#include <Adafruit_SSD1306.h>
#include <Fonts/FreeSans9pt7b.h>

//Initialize SSD1306 OLED
Adafruit_SSD1306 display = Adafruit_SSD1306(128, 64, &Wire, -1); 

//Startup image of weather icons
const unsigned char startup [] PROGMEM = {
  0xff, 0xff, 0xff, 0xff, 0xff, 0xff, 0xff, 0xff, 0xff, 0xff, 0xff, 0xff, 0xff, 0xff, 0xff, 0xff, 
  0xff, 0xff, 0xff, 0xff, 0xff, 0xff, 0xff, 0xff, 0xff, 0xff, 0xff, 0xff, 0xff, 0xff, 0xff, 0xff, 
  0xff, 0xff, 0xff, 0xff, 0xff, 0xff, 0xff, 0xff, 0xff, 0xff, 0xff, 0xff, 0xff, 0xff, 0xff, 0xff, 
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  0xff, 0xff, 0xff, 0xff, 0xff, 0xff, 0xff, 0xff, 0xff, 0xff, 0xff, 0xff, 0xff, 0xff, 0xff, 0xff
};

//Assign your WiFi's SSID and Password to access webpages
const char* ssid = "SpectrumSetup-6B";
const char* password = "voyagefriend495";

//Open weather map api key 
String apiKey= "1a21cebab8d5e01ae7755b7262871e6f"; //key will be specific to your account
String zip = "92337,US";     //put the zip code of your location along with the country code  
WiFiClient wclient;

//=========================================================================
//Demo Array for showing LED weather
//(Uncomment these and the demo code in getWeather() for demo of all LEDs)
//=========================================================================
//int demo_num = 0;
//String forecast[4] = {"Clear", "Snow", "Rain", "Clouds"};

//==================================================
//Setup and define all initial parameters
//==================================================
void setup() 
{ 
  Serial.begin(115200); 
  
  //Default display check
  if(!display.begin(SSD1306_SWITCHCAPVCC, 0x3C)) 
  { 
    Serial.println(F("SSD1306 allocation failed"));
    for(;;);
  }
  
  
  //Set default LCD display options
  delay(2000);
  display.clearDisplay();
  display.setTextSize(1);
  display.setFont(&FreeSans9pt7b);
  
  //Set LEDs
  pinMode(D5, OUTPUT);
  pinMode(D6, OUTPUT);
  pinMode(D7, OUTPUT);
  
  
  //Display startup screen
  display.setCursor(0,14);
  display.setTextColor(WHITE);
  display.print("~~WELCOME~~");
  display.drawBitmap(0,16, startup, 128, 48, WHITE);
  display.invertDisplay(true);
  display.display();
  
  //Make sure we care connected to the internet
  WiFi.begin(ssid, password);
  while (WiFi.status() != WL_CONNECTED) 
  {
    delay(1000);
    Serial.println("Connecting...");
  }
   Serial.println("WiFi connection successful! :)");
    
   //Get current time from global server
   //Convert to PST by doing an offset of 7 hours back
   configTime((-7*3600), 0, "us.pool.ntp.org");
}


void loop()
{
  getWeather();
  delay(10000);
  for(int i=0; i<10; i++) 
  {
    getTime();
    delay(1000);
  }
}

//=========================================================================================
//getWeather() connects to the internet and accesses the openweather link provided
//it uses the zip code and api key of the user to get their location and print out 
//the temperature along with the humidity of that location
//=========================================================================================
void getWeather() 
{
   //Check WiFi connection status
  if (WiFi.status() == WL_CONNECTED) 
  {
    //Declare an object of class HTTPClient
    HTTPClient http; 
    // Request the OpenWeather website location
    http.begin(wclient, "http://api.openweathermap.org/data/2.5/weather?zip=" + zip + "&APPID=" + apiKey + "&units=imperial"); // !!
    //Get the requested data
    int getHttp = http.GET();
    if (getHttp > 0) //data was returned
    {
      String jsonData = http.getString(); //get the data in Json that we need to parse
      DynamicJsonBuffer jsonBuffer(512);
      // Parse JSON object
      JsonObject& root = jsonBuffer.parseObject(jsonData);
      //Default check to make sure we are able to parse through the data
      if(!root.success()) 
      {
        Serial.println(F("Parsing failed!"));
        return;
      }
      float temp = (float)(root["main"]["temp"]); // get temperature in °F
      int humidity = root["main"]["humidity"]; // get humidity in %
      String city = root["name"];
      String weather = root["weather"][0]["main"];
  
      //=====================================
      //***Demo code for full LED Display***
      //=====================================
      //if(demo_num > 3) {demo_num=0;}
      //String weather = forecast[demo_num];
      
      //Print data in serial monitor to check values(COM4)
      Serial.println(city);
      Serial.printf("Temperature: %.2f°F\n", temp);
      Serial.printf("Humidity: %d %%\n", humidity);
      Serial.println(weather);
  
      //Display Weather on OLED
      display.clearDisplay();
      display.invertDisplay(false);
      display.setTextSize(1);
      display.setFont(&FreeSans9pt7b);
      display.setCursor(15, 14);
      display.print("~~"+city+"~~\n");
      display.setFont();
      display.setTextSize(2);
      display.setCursor(25,25);
      display.printf("%.2f", temp);
      display.print((char)247); //degree symbol
      display.print("F\n");
      display.setTextSize(1);
      display.setCursor(27,45);
      display.printf("Humidity: %d%%\n", humidity);
      display.display();
      
      //Set LED according to weather conditions
       if(weather == "Clear") //yellow LED indicates clear/sunny skies
      {
        digitalWrite(D5, HIGH);
        digitalWrite(D6, LOW);
        digitalWrite(D7, LOW);
      }
      else if(weather == "Rain" || weather == "Drizzle" || weather == "Thunderstorm") //blue LED indicates raining
      {
        digitalWrite(D5, LOW);
        digitalWrite(D6, LOW);
        digitalWrite(D7, HIGH);
      }
      else if(weather == "Snow")   //white and blue LED indicate snow 
      {
        digitalWrite(D5, LOW);
        digitalWrite(D6, HIGH);
        digitalWrite(D7, HIGH);
      }
      else if(weather == "Clouds")   //white LED indicated clouds
      {
        digitalWrite(D5, LOW);
        digitalWrite(D6, HIGH);
        digitalWrite(D7, LOW);
      }
      else //other conditions LED is off
      {
        digitalWrite(D5, LOW);
        digitalWrite(D6, LOW);
        digitalWrite(D7, LOW);
      }
    }
    http.end(); //Close connection
  }
  //demo_num++; //***part of demo code for full LED Display***
}

//==============================================================================
//getTime() acts as a clock and gives the time and date 
//in PST. It uses the pool.ntp.org to gain the time from servers
//it needed tweaking but time and date are perfect to the second
//==============================================================================
void getTime() {
time_t curTime = time(nullptr);
struct tm* pt = localtime(&curTime); //Pacific Time Zone time in 24 hour format

display.clearDisplay();
display.invertDisplay(false);
display.setFont(&FreeSans9pt7b); 
display.setTextColor(WHITE);

//Initial time given something like 01/01/1969 so do not display time
//until correct time and date are ready
//(only happens after reprogramming does not show after)
if(pt->tm_year+1900 == 1970) {return;}

//Print date 
display.setTextSize(1);
display.setCursor(25,20);
if(pt->tm_mon+1 < 10){display.print("0");}
display.print(pt->tm_mon+1); 
display.print("/");
if(pt->tm_mday < 10){display.print("0");}
display.print(pt->tm_mday);
display.print("/");
display.print(pt->tm_year+1900); //Adjustment to get correct year(seemed to be a standard in pool.ntp usage)

//Display Hour(Military Time)
display.setTextSize(2);
display.setCursor(0,55);
if(pt->tm_hour < 10){display.print("0");} //ensures 2 digits are shown for hours under 10
display.print(pt->tm_hour);
display.print(":");

//Display Minutes
if(pt->tm_min < 10){display.print("0");} //ensures 2 digits are shown for mins under 10
display.print(pt->tm_min);

//Display Seconds
display.setTextSize(1);
display.setCursor(95,55);
display.print(":");
if( pt->tm_sec <10){display.print("0");} ////ensures 2 digits are shown for secs under 10
display.print(pt->tm_sec+1); //adjustment to perfect the timing
display.display();
 
//delay(1000); 
 
}
